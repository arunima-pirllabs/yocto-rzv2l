## build/conf/bblayers.conf
```bitbake
# POKY_BBLAYERS_CONF_VERSION is increased each time build/conf/bblayers.conf
# changes incompatibly
POKY_BBLAYERS_CONF_VERSION = "2"

BBPATH = "${TOPDIR}"
BBFILES ?= ""

BBLAYERS ?= " \
  /home/pirllabs/workspace_rahul/yocto-rzv2l/meta \
  /home/pirllabs/workspace_rahul/yocto-rzv2l/meta-poky \
  /home/pirllabs/workspace_rahul/yocto-rzv2l/meta-yocto-bsp \
  /home/pirllabs/workspace_rahul/yocto-rzv2l/meta-openembedded/meta-python \
  /home/pirllabs/workspace_rahul/yocto-rzv2l/meta-openembedded/meta-oe \
  /home/pirllabs/workspace_rahul/yocto-rzv2l/meta-openembedded/meta-filesystems \
  /home/pirllabs/workspace_rahul/yocto-rzv2l/meta-openembedded/meta-networking \
  /home/pirllabs/workspace_rahul/yocto-rzv2l/meta-rz-dependency/meta-gplv2 \
  /home/pirllabs/workspace_rahul/yocto-rzv2l/meta-rz-dependency/meta-rz-features/meta-multimedia \
  /home/pirllabs/workspace_rahul/yocto-rzv2l/meta-rz-dependency/meta-renesas/meta-rz-common \
  /home/pirllabs/workspace_rahul/yocto-rzv2l/meta-rz-dependency/meta-renesas/meta-rzg2l \
  /home/pirllabs/workspace_rahul/yocto-rzv2l/meta-rz-dependency/meta-renesas/meta-rzv2l \
  /home/pirllabs/workspace_rahul/yocto-rzv2l/meta-rz-dependency/meta-rz-features/meta-rz-codecs \
  /home/pirllabs/workspace_rahul/yocto-rzv2l/meta-rz-dependency/meta-rz-features/meta-rz-graphics \
  "
```
